## arch/arm64/configs/superbird_evt_512_defconfig
```kconfig
CONFIG_ARM64=y
CONFIG_ARCH_MESON=y
CONFIG_MESON_G12A=y
CONFIG_AMLOGIC_A1_CPUFREQ=y
CONFIG_SOC_AMLOGIC_S905D2=y

CONFIG_ARCH_OPTIONAL_KERNEL_RWX=y
CONFIG_ARCH_OPTIONAL_KERNEL_RWX_DEFAULT=y

CONFIG_EMBEDDED=y
CONFIG_BLK_DEV_INITRD=y

CONFIG_KALLSYMS=y
CONFIG_KALLSYMS_ALL=y

CONFIG_KERNEL_XZ=y
CONFIG_INITRAMFS_SOURCE=""
CONFIG_RD_GZIP=y
CONFIG_RD_LZMA=y
CONFIG_RD_XZ=y
CONFIG_RD_LZO=y
CONFIG_RD_BZIP2=y
CONFIG_RD_LZ4=y
CONFIG_RD_ZSTD=y

CONFIG_LOG_BUF_SHIFT=18
CONFIG_CC_OPTIMIZE_FOR_PERFORMANCE=y

CONFIG_PRINTK_TIME=y
CONFIG_CONSOLE_TRANSLATIONS=y
CONFIG_DEFAULT_CONSOLE_LOGLEVEL=7

CONFIG_DEVTMPFS=y
CONFIG_DEVTMPFS_MOUNT=y
CONFIG_FHANDLE=y
CONFIG_BLK_DEV=y
CONFIG_PARTITION_ADVANCED=y
CONFIG_EFI_PARTITION=y

CONFIG_EXT4_FS=y
CONFIG_FAT_FS=y
CONFIG_MSDOS_FS=y
CONFIG_VFAT_FS=y
CONFIG_TMPFS=y
CONFIG_TMPFS_POSIX_ACL=y

CONFIG_MAGIC_SYSRQ=y
CONFIG_SYSCTL=y
CONFIG_SYSFS=y
CONFIG_PROC_FS=y

CONFIG_SERIAL_AMBA_PL011=y
CONFIG_SERIAL_AMBA_PL011_CONSOLE=y
CONFIG_SERIAL_MESON=y
CONFIG_SERIAL_MESON_CONSOLE=y

CONFIG_INPUT_EVDEV=y
CONFIG_INPUT_KEYBOARD=y
CONFIG_KEYBOARD_GPIO=y
CONFIG_INPUT_MOUSE=y
CONFIG_INPUT_MISC=y

CONFIG_INPUT_UINPUT=y
CONFIG_INPUT_TOUCHSCREEN=y

CONFIG_USB=y
CONFIG_USB_XHCI_HCD=y
CONFIG_USB_XHCI_PLATFORM=y
CONFIG_USB_DWC2=y
CONFIG_USB_STORAGE=y
CONFIG_USB_HID=y

CONFIG_HID=y
CONFIG_HID_GENERIC=y

CONFIG_MMC=y
CONFIG_MMC_MESON_GX=y
CONFIG_MMC_BLOCK=y

CONFIG_I2C=y
CONFIG_I2C_MESON=y

CONFIG_SPI=y
CONFIG_SPI_MESON_SPICC=y
CONFIG_SPI_MESON_SPIFC=y

CONFIG_DMADEVICES=y
CONFIG_AMLOGIC_Meson_DMA=y

CONFIG_FB=y
CONFIG_FB_SIMPLE=y
CONFIG_DRM=y
CONFIG_DRM_MESON=y
CONFIG_DRM_MESON_DW_HDMI=y

CONFIG_SOUND=y
CONFIG_SND=y
CONFIG_SND_SOC=y
CONFIG_SND_SOC_MESON=y
CONFIG_SND_SOC_MESON_G12A_TOACODEC=y
CONFIG_SND_SOC_MESON_T9015=y

CONFIG_REGULATOR=y
CONFIG_REGULATOR_FIXED_VOLTAGE=y

CONFIG_GPIO_SYSFS=y

CONFIG_CRYPTO_DEV_MESON=y

CONFIG_ZSMALLOC=y
CONFIG_ZRAM=y
CONFIG_ZRAM_DEF_COMP_LZ4=y
CONFIG_ZRAM_WRITEBACK=y

CONFIG_TMPFS=y
CONFIG_TMPFS_POSIX_ACL=y

CONFIG_WATCHDOG=y
CONFIG_MESON_WATCHDOG=y
```
